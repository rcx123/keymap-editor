## Cyber50/Kconfig.defconfig
```kconfig
# Copyright (c) 2020 The ZMK Contributors
# SPDX-License-Identifier: MIT

if SHIELD_Cyber50

config ZMK_KEYBOARD_NAME
	default "Cyber50"

endif
```

## Cyber50/Kconfig.shield
```kconfig
# Copyright (c) 2020 The ZMK Contributors
# SPDX-License-Identifier: MIT

config SHIELD_Cyber50
	def_bool $(shields_list_contains,Cyber50)
```
